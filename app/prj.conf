## CMakeLists.txt
```
cmake_minimum_required(VERSION 3.20.0)

find_package(Zephyr REQUIRED HINTS $ENV{ZEPHYR_BASE})
project(sensebox)

MACRO(RECURSE_FILES return_list filter)
    FILE(GLOB_RECURSE new_list ${filter})
    SET(file_list "")
    FOREACH(file_path ${new_list})
        SET(file_list ${file_list} ${file_path})
    ENDFOREACH()
    LIST(REMOVE_DUPLICATES file_list)
    SET(${return_list} ${file_list})
ENDMACRO()

# recursively get all src files
RECURSE_FILES(cpp_file_list src/*.cpp)
RECURSE_FILES(c_file_list src/*.c)

target_sources(app PRIVATE ${cpp_file_list} ${c_file_list})
```

## sample.yaml
```
sample:
  description: Sensebox Firmware
  name: Sensebox
```

## prj.conf
```kconfig
CONFIG_GPIO=y

# C++ support
CONFIG_CPLUSPLUS=y
CONFIG_LIB_CPLUSPLUS=y
CONFIG_EXCEPTIONS=n
CONFIG_NEWLIB_LIBC=n
CONFIG_NEWLIB_LIBC_NANO=n
```

## app.overlay
```dts
/ {
    aliases {
        statusled = &status_led;
    };

    leds {
        compatible = "gpio-leds";
        status_led: led_gpio_2 {
            gpios = <&gpio0 2 GPIO_ACTIVE_LOW>;
        };
    };
};
```

## src/main.cpp
```c
#include "led.hpp"
#include <sys/printk.h>

void main() {

    printk("Board: %s", CONFIG_BOARD);
    
    Led status_led;

    status_led = Led(GPIO_DT_SPEC_GET(DT_ALIAS(statusled), gpios));

    while (true) {    
        status_led.toggle();
        k_msleep(500);
    }

    //noreturn
}
```

## src/led.cpp
```c
#include "led.hpp"

Led::Led() {}

Led::Led(gpio_dt_spec device) {
    m_device = device;

    if (!device_is_ready(m_device.port)) {
        // throw "LED is not ready.";
    }

    if (gpio_pin_configure_dt(&m_device, GPIO_OUTPUT_ACTIVE)) {
        // throw "Failed to configure LED device";
    }
}

void Led::toggle() {
    if (gpio_pin_toggle_dt(&m_device) < 0) {
        // throw "Failed to toggle LED";
    }
}
```

## src/led.hpp
```c
#pragma once
#include <drivers/gpio.h>

class Led {
    gpio_dt_spec m_device;

public:
    void toggle();
    Led();
    Led(gpio_dt_spec device);
};
```
